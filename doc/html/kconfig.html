## sdk/share/bluetooth_bta/Kconfig
```kconfig
menuconfig BRCM_BT_ENABLED
    bool "Broadcom BT"
    default y

    if BRCM_BT_ENABLED
        source "$RTT_DIR/third_party/brcm_bt/pack/Kconfig"
    endif
```

## sdk/share/mediastreamer2/Kconfig
```kconfig
#
# For a description of the syntax of this configuration file,
# see Documentation/kbuild/kconfig-language.txt.
#

config BUILD_EXOSIP2
	def_bool y if BUILD_MEDIASTREAMER2

config BUILD_FFMPEG
	def_bool y if (BUILD_MEDIASTREAMER2 && LCD_ENABLE)

if NET_LWIP
config BUILD_LWIP
	def_bool y if BUILD_MEDIASTREAMER2
endif

if NET_LWIP_2
config BUILD_LWIP_2
	def_bool y if BUILD_MEDIASTREAMER2
endif

config BUILD_SDL
	def_bool y if BUILD_MEDIASTREAMER2

config BUILD_SPEEX
	def_bool y if BUILD_MEDIASTREAMER2

config BUILD_ORTP
	def_bool y if BUILD_MEDIASTREAMER2
	
```
